# file: Aula2_2.ioc
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Mcu.Family=STM32F3
Mcu.Name=STM32F334R(6-8)Tx
Mcu.Package=LQFP64
NVIC.PriorityGroup=NVIC_PRIORITYGROUP_4
PA5.GPIO_Label=LD2
PA5.Signal=GPIO_Output
ProjectManager.HeapSize=0x200
ProjectManager.StackSize=0x400
ProjectManager.TargetToolchain=CMake
RCC.AHBFreq_Value=8000000
RCC.APB1Freq_Value=8000000
RCC.APB2Freq_Value=8000000
RCC.CortexFreq_Value=8000000
RCC.HSE_VALUE=8000000
RCC.HSI_VALUE=8000000
RCC.LSE_VALUE=32768
RCC.SYSCLKFreq_VALUE=8000000
board=custom

// file: Core/Src/main.c
/* USER CODE BEGIN Header */
/**
  ******************************************************************************
  * @file           : main.c
  * @brief          : Main program body
  ******************************************************************************
  * @attention
  *
  * Copyright (c) 2026 STMicroelectronics.
  * All rights reserved.
  *
  * This software is licensed under terms that can be found in the LICENSE file
  * in the root directory of this software component.
  * If no LICENSE file comes with this software, it is provided AS-IS.
  *
  ******************************************************************************
  */
/* USER CODE END Header */
#include "main.h"
#include "gpio.h"
#include "stm32f3xx_hal.h"
#include "stm32f3xx_hal_gpio.h"

void SystemClock_Config(void);

/* USER CODE BEGIN 0 */
typedef enum {
  ESTADO_SETUP,
  ESTADO_PISCA,
  ESTADO_ALTERA_VELOCIDADE,
  ESTADO_SAIR
} Estado;

typedef struct {
  int frequenciaMaxima;
  int frequenciaMinima;
  int intervaloFrequencia;
  int frequenciaAtual;
  int contadorPiscadas;
} Contexto;

typedef Estado EstadoFunc(Contexto *ctx);

/* USER CODE END 0 */

int main(void)
{

  /* MCU Configuration--------------------------------------------------------*/

  /* Reset of all peripherals, Initializes the Flash interface and the Systick. */
  HAL_Init();

  /* Configure the system clock */
  SystemClock_Config();

  /* Initialize all configured peripherals */
  MX_GPIO_Init();

  /* Infinite loop */
  Contexto ctx;
  Estado estadoAtual = ESTADO_SETUP;
  EstadoFunc *tabelaEstados[] = {
    [ESTADO_SETUP] = setup,
    [ESTADO_PISCA] = pisca,
    [ESTADO_ALTERA_VELOCIDADE] = alteraVelocidade,
  }

  while (estadoAtual != ESTADO_SAIDA)
  {
    estadoAtual = tabelaEstados[estadoAtual](&ctx);
  }
}

void SystemClock_Config(void)
{
  RCC_OscInitTypeDef RCC_OscInitStruct = {0};
  RCC_ClkInitTypeDef RCC_ClkInitStruct = {0};

  /** Initializes the RCC Oscillators according to the specified parameters
  * in the RCC_OscInitTypeDef structure.
  */
  RCC_OscInitStruct.OscillatorType = RCC_OSCILLATORTYPE_HSI;
  RCC_OscInitStruct.HSIState = RCC_HSI_ON;
  RCC_OscInitStruct.HSICalibrationValue = RCC_HSICALIBRATION_DEFAULT;
  RCC_OscInitStruct.PLL.PLLState = RCC_PLL_NONE;
  if (HAL_RCC_OscConfig(&RCC_OscInitStruct) != HAL_OK)
  {
    Error_Handler();
  }

  /** Initializes the CPU, AHB and APB buses clocks
  */
  RCC_ClkInitStruct.ClockType = RCC_CLOCKTYPE_HCLK|RCC_CLOCKTYPE_SYSCLK
                              |RCC_CLOCKTYPE_PCLK1|RCC_CLOCKTYPE_PCLK2;
  RCC_ClkInitStruct.SYSCLKSource = RCC_SYSCLKSOURCE_HSI;
  RCC_ClkInitStruct.AHBCLKDivider = RCC_SYSCLK_DIV1;
  RCC_ClkInitStruct.APB1CLKDivider = RCC_HCLK_DIV1;
  RCC_ClkInitStruct.APB2CLKDivider = RCC_HCLK_DIV1;

  if (HAL_RCC_ClockConfig(&RCC_ClkInitStruct, FLASH_LATENCY_0) != HAL_OK)
  {
    Error_Handler();
  }
}

/* USER CODE BEGIN 4 */

Estado setup(Contexto *ctx) {
  ctx->contadorPiscadas = 0;
  ctx->frequenciaMinima = 30;
  ctx->frequenciaMaxima = 120;
  ctx->intervaloFrequencia = (ctx->frequenciaMaxima - ctx->frequenciaMinima)/3;
  ctx->frequenciaAtual = ctx->frequenciaMinima;
  return ESTADO_PISCA;
}

Estado pisca(Contexto *ctx) {
  HAL_GPIO_TogglePin(LD2_GPIO_Port, LD2_Pin);
  HAL_Delay((1/(2*(frequenciaAtual/60)))*1000);
  HAL_GPIO_TogglePin(LD2_GPIO_Port, LD2_Pin);
  HAL_Delay((1/(2*(frequenciaAtual/60)))*1000);
}

Estado alteraVelocidade(Contexto *ctx) {
  ctx->frequenciaAtual += ctx->intervaloFrequencia;
  if (ctx->frequenciaAtual > ctx->frequenciaMaxima) {
    ctx->frequenciaAtual = ctx->frequenciaMinima;
  }
  return ESTADO_PISCA;
}

/* USER CODE END 4 */

void Error_Handler(void)
{
  __disable_irq();
  while (1)
  {
  }
}
